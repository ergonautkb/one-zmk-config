## config/boards/shields/ergonaut_one/Kconfig.defconfig
```kconfig
# Copyright (c) 2020 The ZMK Contributors
# SPDX-License-Identifier: MIT

if SHIELD_ERGONAUT_ONE_LEFT

config ZMK_KEYBOARD_NAME
	default "Ergonaut One"

config ZMK_SPLIT_ROLE_CENTRAL
	default y

endif

if SHIELD_ERGONAUT_ONE_LEFT || SHIELD_ERGONAUT_ONE_RIGHT

config ZMK_SPLIT
	default y

endif
```

## config/boards/shields/ergonaut_one/Kconfig.shield
```kconfig
# Copyright (c) 2020 The ZMK Contributors
# SPDX-License-Identifier: MIT

config SHIELD_ERGONAUT_ONE_LEFT
    def_bool $(shields_list_contains,ergonaut_one_left)

config SHIELD_ERGONAUT_ONE_RIGHT
    def_bool $(shields_list_contains,ergonaut_one_right)
```
